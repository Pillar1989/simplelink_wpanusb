/**
 * @cliArgs --board "/ti/boards/CC1352P_2_LAUNCHXL" --product "simplelink_cc13x2_26x2_sdk@4.40.00.44"
 * @versions {"data":"2020120115","timestamp":"2020120115","tool":"1.7.0+1696","templates":null}
 */

/**
 * Import the modules used in this configuration.
 */
const CCFG     = scripting.addModule("/ti/devices/CCFG");
const custom   = scripting.addModule("/ti/devices/radioconfig/custom");
const rfdesign = scripting.addModule("/ti/devices/radioconfig/rfdesign");
const GPIO     = scripting.addModule("/ti/drivers/GPIO");
const GPIO1    = GPIO.addInstance();
const RF       = scripting.addModule("/ti/drivers/RF");
const RTOS     = scripting.addModule("/ti/drivers/RTOS");
const UART2    = scripting.addModule("/ti/drivers/UART2");
const UART21   = UART2.addInstance();
const UART22   = UART2.addInstance();

/**
 * Write custom configuration values to the imported modules.
 */
CCFG.forceVddr          = true;
CCFG.ccfgTemplate.$name = "ti_devices_CCFGTemplate0";

custom.ieee                                                      = ["ieee154"];
custom.prop8                                                     = ["2gfsk200kbps154g"];
custom.radioConfigieee154.$name                                  = "ti_devices_radioconfig_settings_ieee_15_40";
custom.radioConfigieee154.codeExportConfig.$name                 = "ti_devices_radioconfig_code_export_param0";
custom.radioConfig2gfsk200kbps154g.$name                         = "ti_devices_radioconfig_settings_prop0";
custom.radioConfig2gfsk200kbps154g.codeExportConfig.$name        = "ti_devices_radioconfig_code_export_param1";
custom.radioConfig2gfsk200kbps154g.codeExportConfig.symGenMethod = "Legacy";
custom.radioConfig2gfsk200kbps154g.codeExportConfig.paExport     = "combined";

rfdesign.rfDesign = "LAUNCHXL-CC1352P-2";
rfdesign.pa20     = "fbSub1g";

GPIO1.$hardware         = system.deviceData.board.components.LED_RED;
GPIO1.$name             = "CONFIG_GPIO_LED_0";
GPIO1.pinInstance.$name = "CONFIG_PIN_0";

RF.globalCallbackFunction = "rfDriverCallback";
RF.globalEventMask        = ["RF_GlobalEventCmdStart","RF_GlobalEventCmdStop","RF_GlobalEventCoexControl"];

UART21.$name               = "CONFIG_UART2_0";
UART21.$hardware           = system.deviceData.board.components.XDS110UART;
UART21.txPinInstance.$name = "CONFIG_PIN_1";
UART21.rxPinInstance.$name = "CONFIG_PIN_2";

UART22.$name               = "CONFIG_UART2_1";
UART22.uart.txPin.$assign  = "boosterpack.9";
UART22.uart.rxPin.$assign  = "boosterpack.5";
UART22.txPinInstance.$name = "CONFIG_PIN_3";
UART22.rxPinInstance.$name = "CONFIG_PIN_4";

/**
 * Pinmux solution for unlocked pins/peripherals. This ensures that minor changes to the automatic solver in a future
 * version of the tool will not impact the pinmux you originally saw.  These lines can be completely deleted in order to
 * re-solve from scratch.
 */
GPIO1.gpioPin.$suggestSolution     = "boosterpack.39";
UART21.uart.$suggestSolution       = "UART1";
UART21.uart.txPin.$suggestSolution = "boosterpack.4";
UART21.uart.rxPin.$suggestSolution = "boosterpack.3";
UART22.uart.$suggestSolution       = "UART0";
